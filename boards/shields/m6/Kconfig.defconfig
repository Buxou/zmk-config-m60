## boards/shields/m6/Kconfig.defconfig
```kconfig
# Copyright (c) 2020 The ZMK Contributors
# SPDX-License-Identifier: MIT

if SHIELD_M6

config ZMK_KEYBOARD_NAME
    default "m6"

endif
```

## boards/shields/m6/Kconfig.shield
```kconfig
# Copyright (c) 2020 The ZMK Contributors
# SPDX-License-Identifier: MIT

config SHIELD_M6
    def_bool $(shields_list_contains,m6)
```
